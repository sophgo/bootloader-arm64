## u-boot/ramdisk/configs/qemu/multi.its
```
/*
 * U-Boot uImage source file with multiple kernels, ramdisks and FDT blobs
 */

/dts-v1/;

/ {
	description = "Various kernels, ramdisks and FDT blobs";
	#address-cells = <2>;

	images {
		kernel {
			description = "QEMU kernel";
			data = /incbin/("./Image");
			type = "kernel";
			arch = "arm64";
			os = "linux";
			compression = "none";
			load = <0x40400000>;
			entry = <0x40400000>;
			hash {
				algo = "sha1";
			};
		};

		ramdisk {
			description = "bitmain ramdisk";
			data = /incbin/("./rootfs.cpio");
			type = "ramdisk";
			arch = "arm64";
			os = "linux";
			compression = "none";
			hash {
				algo = "sha1";
			};
		};

		fdt {
			description = "QEMU device tree";
			data = /incbin/("./qemu.dtb");
			type = "flat_dt";
			arch = "arm64";
			compression = "none";
			hash {
				algo = "sha1";
			};
		};
	};

	configurations {
		default = "config";

		config {
			description = "boot a minimal system from RAM";
			kernel = "kernel";
			ramdisk = "ramdisk";
			fdt = "fdt";
		};
	};
};
```
