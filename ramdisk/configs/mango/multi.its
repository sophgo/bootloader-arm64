## ramdisk/configs/mango/multi.its
```
/*
 * U-Boot uImage source file with multiple kernels, ramdisks and FDT blobs
 */

/dts-v1/;

/ {
	description = "Various kernels, ramdisks and FDT blobs";
	#address-cells = <2>;

	images {
		kernel {
			description = "bitmain kernel";
			data = /incbin/("./Image");
			type = "kernel";
			arch = "arm64";
			os = "linux";
			compression = "none";
			load = <0x0 0x00080000>;
			entry = <0x0 0x00080000>;
			/*
			hash {
				algo = "sha1";
			};
			*/
		};

		ramdisk {
			description = "bitmain ramdisk";
			data = /incbin/("./rootfs.cpio");
			type = "ramdisk";
			arch = "arm64";
			os = "linux";
			compression = "none";
			load = <00000000>;
			entry = <00000000>;
			/*
			hash {
				algo = "sha1";
			};
			*/
		};

		fdt-pcb0 {
			description = "for Palladium";
			data = /incbin/("./mango_pld.dtb");
			type = "flat_dt";
			arch = "arm64";
			compression = "none";
			/*
			hash {
				algo = "sha1";
			};
			*/
		};

		fdt-pcb1 {
			description = "for FPGA";
			data = /incbin/("./mango_fpga.dtb");
			type = "flat_dt";
			arch = "arm64";
			compression = "none";
			/*
			hash {
				algo = "sha1";
			};
			*/
		};
	};

	configurations {
		default = "config-pcb0";

		config-pcb0 {
			description = "for Palladium";
			kernel = "kernel";
			ramdisk = "ramdisk";
			fdt = "fdt-pcb0";
			signature {
				algo = "sha1,rsa2048";
				key-name-hint = "vboot";
				sign-images = "fdt", "ramdisk", "kernel";
			};
		};

		config-pcb1 {
			description = "for FPGA";
			kernel = "kernel";
			ramdisk = "ramdisk";
			fdt = "fdt-pcb1";
			signature {
				algo = "sha1,rsa2048";
				key-name-hint = "vboot";
				sign-images = "fdt", "ramdisk", "kernel";
			};
		};
	};
};
```

## scripts/buildroot-2019.08.2/qemu_aarch64_virt_defconfig
```kconfig
# Architecture
BR2_aarch64=y
BR2_cortex_a53=y

# System
BR2_SYSTEM_DHCP="eth0"
BR2_TARGET_GENERIC_GETTY_PORT="ttyAMA0"

# Filesystem
BR2_TARGET_ROOTFS_EXT2=y
BR2_TARGET_ROOTFS_EXT2_4=y
# BR2_TARGET_ROOTFS_TAR is not set

# Linux headers same as kernel, a 4.19 series
BR2_PACKAGE_HOST_LINUX_HEADERS_CUSTOM_4_19=y

# Kernel
BR2_LINUX_KERNEL=y
BR2_LINUX_KERNEL_CUSTOM_VERSION=y
BR2_LINUX_KERNEL_CUSTOM_VERSION_VALUE="4.19.16"
BR2_LINUX_KERNEL_USE_CUSTOM_CONFIG=y
BR2_LINUX_KERNEL_CUSTOM_CONFIG_FILE="board/qemu/aarch64-virt/linux.config"
BR2_LINUX_KERNEL_NEEDS_HOST_OPENSSL=y

# host-qemu for gitlab testing
BR2_PACKAGE_HOST_QEMU=y
BR2_PACKAGE_HOST_QEMU_SYSTEM_MODE=y

###############################################################################
# filesystem tools
BR2_PACKAGE_UTIL_LINUX=y
BR2_PACKAGE_UTIL_LINUX_BINARIES=y
BR2_PACKAGE_UTIL_LINUX_FSCK=y
BR2_PACKAGE_E2FSPROGS=y
BR2_PACKAGE_GPTFDISK=y
BR2_PACKAGE_GPTFDISK_SGDISK=y

# system tools
BR2_PACKAGE_KEXEC=y

# peripheral tools
BR2_PACKAGE_PCIUTILS=y
BR2_PACKAGE_SPI_TOOLS=y
BR2_PACKAGE_ETHTOOL=y
```

## scripts/buildroot-2021.02.7/qemu_aarch64_virt_defconfig
```kconfig
# Architecture
BR2_aarch64=y
BR2_cortex_a53=y

# System
BR2_SYSTEM_DHCP="eth0"
BR2_TARGET_GENERIC_GETTY_PORT="ttyAMA0"

# Filesystem
BR2_TARGET_ROOTFS_EXT2=y
BR2_TARGET_ROOTFS_EXT2_4=y
# BR2_TARGET_ROOTFS_TAR is not set

# Image
BR2_ROOTFS_POST_IMAGE_SCRIPT="board/qemu/post-image.sh"
BR2_ROOTFS_POST_SCRIPT_ARGS="$(BR2_DEFCONFIG)"

# Linux headers same as kernel, a 5.4 series
BR2_PACKAGE_HOST_LINUX_HEADERS_CUSTOM_5_4=y

# Kernel
BR2_LINUX_KERNEL=y
BR2_LINUX_KERNEL_CUSTOM_VERSION=y
BR2_LINUX_KERNEL_CUSTOM_VERSION_VALUE="5.4.88"
BR2_LINUX_KERNEL_USE_CUSTOM_CONFIG=y
BR2_LINUX_KERNEL_CUSTOM_CONFIG_FILE="board/qemu/aarch64-virt/linux.config"
BR2_LINUX_KERNEL_NEEDS_HOST_OPENSSL=y

# host-qemu for gitlab testing
BR2_PACKAGE_HOST_QEMU=y
BR2_PACKAGE_HOST_QEMU_SYSTEM_MODE=y


###############################################################################
# filesystem tools
BR2_PACKAGE_UTIL_LINUX=y
BR2_PACKAGE_UTIL_LINUX_BINARIES=y
BR2_PACKAGE_UTIL_LINUX_FSCK=y
BR2_PACKAGE_E2FSPROGS=y
BR2_PACKAGE_GPTFDISK=y
BR2_PACKAGE_GPTFDISK_SGDISK=y

# system tools
BR2_PACKAGE_KEXEC=y
BR2_PACKAGE_OPENSSL=y
BR2_PACKAGE_OPENSSH=y
BR2_PACKAGE_GDB=y
BR2_PACKAGE_GDB_SERVER=y
BR2_PACKAGE_GDB_DEBUGGER=y
BR2_PACKAGE_GDB_TUI=y
BR2_PACKAGE_GLIBC_UTILS=y
BR2_PACKAGE_MEMTESTER=y

# peripheral tools
BR2_PACKAGE_PCIUTILS=y
BR2_PACKAGE_SPI_TOOLS=y
BR2_PACKAGE_ETHTOOL=y
BR2_PACKAGE_TCPDUMP=y

# lib
BR2_SHARED_STATIC_LIBS=y
BR2_PACKAGE_LIBNSS=y
BR2_PACKAGE_LIBUV=y
BR2_PACKAGE_HWLOC=y

# toolchain
BR2_TOOLCHAIN_BUILDROOT_GLIBC=y
BR2_TOOLCHAIN_BUILDROOT_CXX=y
BR2_GCC_VERSION_9_X=y
```

## u-boot/board/bitmain/bm1684/Kconfig
```kconfig
if ARCH_BM1684

config SYS_BOARD
	default "bm1684"

config SYS_VENDOR
	default "bitmain"

config SYS_CONFIG_NAME
	default "bitmain_bm1684"

endif
```

## u-boot/board/sophgo/mango/Kconfig
```kconfig
if ARCH_MANGO

config SYS_VENDOR
	default "sophgo"

config SYS_BOARD
	default "mango"

config SYS_CONFIG_NAME
	default "sophgo_mango"

endif
```

## u-boot/configs/bitmain_bm1684_defconfig
```kconfig
CONFIG_ARM=y
CONFIG_ARCH_BM1684=y
CONFIG_TEXT_BASE=0x308000000
CONFIG_SYS_MEMTEST_START=0x300040000
CONFIG_SYS_MEMTEST_END=0x300080000
CONFIG_PRE_CON_BUF_ADDR=0x300080000
CONFIG_SYS_LOAD_ADDR=0x300280000
CONFIG_HAS_CUSTOM_SYS_INIT_SP_ADDR=y
CONFIG_CUSTOM_SYS_INIT_SP_ADDR=0x303F00000
CONFIG_PRE_CON_BUF_SZ=8192
CONFIG_ENV_SIZE=0x2000
CONFIG_ENV_OFFSET=0x1C0000
CONFIG_ENV_SECT_SIZE=0x10000
CONFIG_NR_DRAM_BANKS=2
CONFIG_SYS_MALLOC_F_LEN=0x2000
CONFIG_IDENT_STRING=" Sophon BM1684"
CONFIG_DISTRO_DEFAULTS=y
CONFIG_BOOTDELAY=1
# CONFIG_DISPLAY_CPUINFO is not set
# CONFIG_DISPLAY_BOARDINFO is not set
CONFIG_SYS_PROMPT="bm1684# "
# CONFIG_CMD_CONSOLE is not set
# CONFIG_CMD_IMLS is not set
# CONFIG_CMD_XIMG is not set
# CONFIG_CMD_EDITENV is not set
# CONFIG_CMD_ENV_EXISTS is not set
CONFIG_CMD_MEMTEST=y
CONFIG_CMD_UNZIP=y
CONFIG_CMD_MMC=y
# CONFIG_CMD_LOADS is not set
# CONFIG_CMD_ARMFLASH is not set
# CONFIG_CMD_FPGA is not set
# CONFIG_CMD_ITEST is not set
# CONFIG_CMD_SETEXPR is not set
CONFIG_CMD_NFS=y
CONFIG_CMD_CACHE=y
CONFIG_CMD_FAT=y
CONFIG_CMD_GPT=y
# CONFIG_ISO_PARTITION is not set
# CONFIG_EFI_PARTITION is not set
CONFIG_BLK=y
CONFIG_CLK=y
CONFIG_MMC=y
# CONFIG_MTD_NOR_FLASH is not set
CONFIG_OF_LIBFDT=y
CONFIG_OF_CONTROL=y
CONFIG_OF_SEPARATE=y
CONFIG_DEFAULT_DEVICE_TREE="bitmain-bm1684-evb-v1.2"
CONFIG_OF_LIST="bitmain-bm1684-cust-v1 bitmain-bm1684-se5-v2 bitmain-bm1684-sm5-v1 bitmain-bm1684-evb-v1.2 bitmain-bm1684-se6-ctrl bitmain-bm1684-se5-v1.1 bitmain-bm1684-sm5m bitmain-bm1684x-fpga bitmain-bm1684x-pld bitmain-bm1684x-evb-v0.0 bitmain-bm1684x-ep bitmain-bm1684x-sm7m-v0.0 bitmain-bm1684x-sm7-ctrl bitmain-bm1684x-sm7m-v0.0-cust-v1 bitmain-bm1684x-se7-v1 bitmain-bm1684x-sm7m-ctrl bitmain-bm1684x-sm7m-v1.0 bitmain-bm1684x-sm7m-v1.2 bitmain-bm1684x-sm7m-v1.0-ctrl bitmain-bm1684x-m2-cust02-v0.0"
CONFIG_SYS_NS16550=y
CONFIG_BAUDRATE=115200
CONFIG_PHY_BROADCOM=y
CONFIG_PHY_MARVELL=y
CONFIG_PHY_REALTEK=y
CONFIG_PHY_MOTORCOMM=y
# CONFIG_PHY_FIXED is not set
CONFIG_NETDEVICES=y
CONFIG_NET_RANDOM_ETHADDR=y
CONFIG_FIT=y
# CONFIG_ARCH_FIXUP_FDT_MEMORY is not set
CONFIG_SPI_FLASH_STMICRO=y
CONFIG_SPI_FLASH_GIGADEVICE=y
CONFIG_SPI_FLASH_WINBOND=y
CONFIG_SPI_FLASH_MACRONIX=y
CONFIG_SPI_FLASH_XMC=y
CONFIG_CMD_SF=y
CONFIG_CMD_SAVEENV=y
CONFIG_MTD=y
CONFIG_CMD_DM=y
CONFIG_FIT_SIGNATURE=y
CONFIG_RSA=y
# CONFIG_IMI=y
# CONFIG_FIT_VERBOSE=y
CONFIG_CMD_I2C=y
# CONFIG_TOOLS_DEBUG=y
CONFIG_CMD_MISC=y
CONFIG_CMD_BM_MMCBCB=y
CONFIG_CMD_EXT4_WRITE=y
CONFIG_DM_PCA953X=y
CONFIG_LED=y
CONFIG_LED_GPIO=y
CONFIG_CMD_LED=y
CONFIG_ENV_IS_IN_FAT=y
CONFIG_ENV_FAT_INTERFACE="mmc"
CONFIG_ENV_FAT_DEVICE_AND_PART="0:1"
CONFIG_ENV_FAT_FILE="uboot.env"
CONFIG_MULTI_DTB_FIT=y
CONFIG_SPL_MULTI_DTB_FIT=y
CONFIG_SPL_MULTI_DTB_FIT_NO_COMPRESSION=y
CONFIG_CONSOLE_RECORD=y
CONFIG_CONSOLE_RECORD_OUT_SIZE=0x2000
CONFIG_PRE_CONSOLE_BUFFER=y
CONFIG_LEGACY_IMAGE_FORMAT=y
CONFIG_LMB_MAX_REGIONS=16
CONFIG_BITMAIN_WATCHDOG=y
CONFIG_PINCTRL=y
CONFIG_CMD_BM_SAVELOG=y
CONFIG_PINCTRL_BM1684=y
CONFIG_PHY_GIGE=y
CONFIG_BM_PCA9545_MUX=y
CONFIG_REMAKE_ELF=y
CONFIG_USE_IPADDR=y
CONFIG_IPADDR="192.168.1.250"
CONFIG_USE_NETMASK=y
CONFIG_NETMASK="255.255.255.0"
CONFIG_USE_GATEWAYIP=y
CONFIG_GATEWAYIP="192.168.1.1"
CONFIG_USE_SERVERIP=y
CONFIG_SERVERIP="192.168.1.100"
CONFIG_USE_HOSTNAME=y
CONFIG_HOSTNAME="unknown"
CONFIG_USE_ROOTPATH=y
CONFIG_ROOTPATH="/home/share/nfsroot"
CONFIG_SYS_HAS_NONCACHED_MEMORY=y
CONFIG_SYS_NONCACHED_MEMORY=0x100000
```

## u-boot/configs/sophgo_mango_defconfig
```kconfig
CONFIG_ARM=y
CONFIG_ARCH_MANGO=y
CONFIG_TEXT_BASE=0x0008000000
CONFIG_SYS_MEMTEST_START=0x0005040000
CONFIG_SYS_MEMTEST_END=0x0005080000
CONFIG_PRE_CON_BUF_ADDR=0x0005080000
CONFIG_SYS_LOAD_ADDR=0x0016800000
CONFIG_HAS_CUSTOM_SYS_INIT_SP_ADDR=y
CONFIG_CUSTOM_SYS_INIT_SP_ADDR=0x0000300000
CONFIG_PRE_CON_BUF_SZ=8192
CONFIG_ENV_SIZE=0x2000
CONFIG_NR_DRAM_BANKS=1
CONFIG_SYS_MALLOC_F_LEN=0x2000
CONFIG_IDENT_STRING=" Sophgo Mango"
CONFIG_DISTRO_DEFAULTS=y
CONFIG_BOOTDELAY=1
# CONFIG_DISPLAY_CPUINFO is not set
# CONFIG_DISPLAY_BOARDINFO is not set
CONFIG_SYS_PROMPT="mango# "
# CONFIG_CMD_CONSOLE is not set
# CONFIG_CMD_IMLS is not set
# CONFIG_CMD_XIMG is not set
# CONFIG_CMD_EDITENV is not set
# CONFIG_CMD_ENV_EXISTS is not set
CONFIG_CMD_MEMTEST=y
CONFIG_CMD_UNZIP=y
CONFIG_CMD_MMC=y
# CONFIG_CMD_LOADS is not set
# CONFIG_CMD_ARMFLASH is not set
# CONFIG_CMD_FPGA is not set
# CONFIG_CMD_ITEST is not set
# CONFIG_CMD_SETEXPR is not set
CONFIG_CMD_NFS=y
CONFIG_CMD_CACHE=y
CONFIG_CMD_FAT=y
CONFIG_CMD_GPT=y
# CONFIG_ISO_PARTITION is not set
# CONFIG_EFI_PARTITION is not set
CONFIG_BLK=y
CONFIG_CLK=y
CONFIG_MMC=y
# CONFIG_MTD_NOR_FLASH is not set
CONFIG_OF_LIBFDT=y
CONFIG_OF_CONTROL=y
CONFIG_OF_SEPARATE=y
CONFIG_DEFAULT_DEVICE_TREE="sophgo-mango-pld"
CONFIG_OF_LIST="sophgo-mango-pld sophgo-mango-fpga sophgo-mango-evb-v0.0"
CONFIG_SYS_NS16550=y
CONFIG_BAUDRATE=115200
CONFIG_PHY_BROADCOM=y
CONFIG_PHY_MARVELL=y
CONFIG_PHY_REALTEK=y
# CONFIG_PHY_FIXED is not set
CONFIG_NETDEVICES=y
CONFIG_NET_RANDOM_ETHADDR=y
CONFIG_FIT=y
# CONFIG_ARCH_FIXUP_FDT_MEMORY is not set
CONFIG_SPI_FLASH_STMICRO=y
CONFIG_SPI_FLASH_GIGADEVICE=y
CONFIG_CMD_SF=y
CONFIG_CMD_SAVEENV=y
CONFIG_MTD=y
CONFIG_CMD_DM=y
CONFIG_FIT_SIGNATURE=y
CONFIG_RSA=y
# CONFIG_IMI=y
# CONFIG_FIT_VERBOSE=y
CONFIG_CMD_I2C=y
# CONFIG_TOOLS_DEBUG=y
CONFIG_CMD_MISC=y
CONFIG_CMD_BM_MMCBCB=y
CONFIG_CMD_EXT4_WRITE=y
# CONFIG_DM_PCA953X is not set
# CONFIG_LED is not set
# CONFIG_LED_GPIO is not set
# CONFIG_CMD_LED is not set
CONFIG_ENV_IS_IN_FAT=y
CONFIG_ENV_FAT_INTERFACE="mmc"
CONFIG_ENV_FAT_DEVICE_AND_PART="0:1"
CONFIG_ENV_FAT_FILE="uboot.env"
CONFIG_MULTI_DTB_FIT=y
CONFIG_SPL_MULTI_DTB_FIT=y
CONFIG_SPL_MULTI_DTB_FIT_NO_COMPRESSION=y
CONFIG_CONSOLE_RECORD=y
CONFIG_CONSOLE_RECORD_OUT_SIZE=0x2000
CONFIG_PRE_CONSOLE_BUFFER=y
CONFIG_LEGACY_IMAGE_FORMAT=y
CONFIG_LMB_MAX_REGIONS=16
CONFIG_BITMAIN_WATCHDOG=y
CONFIG_PINCTRL=y
CONFIG_CMD_BM_SAVELOG=y
CONFIG_PINCTRL_MANGO=y
CONFIG_PHY_GIGE=y
CONFIG_DM_RTC=y
CONFIG_RTC_MANGO=y
CONFIG_REMAKE_ELF=y
CONFIG_USE_IPADDR=y
CONFIG_IPADDR="192.168.1.250"
CONFIG_USE_NETMASK=y
CONFIG_NETMASK="255.255.255.0"
CONFIG_USE_GATEWAYIP=y
CONFIG_GATEWAYIP="192.168.1.1"
CONFIG_USE_SERVERIP=y
CONFIG_SERVERIP="192.168.1.100"
CONFIG_USE_HOSTNAME=y
CONFIG_HOSTNAME="unknown"
CONFIG_USE_ROOTPATH=y
CONFIG_ROOTPATH="/home/share/nfsroot"
CONFIG_SYS_HAS_NONCACHED_MEMORY=y
CONFIG_SYS_NONCACHED_MEMORY=0x100000
```

## u-boot/drivers/pinctrl/bitmain/Kconfig
```kconfig
config PINCTRL_BITMAIN
	bool

config PINCTRL_BM1684
	bool "Bitmain BM1684 pinctrl driver"
	depends on ARCH_BM1684 && PINCTRL_FULL
	select PINCTRL_BITMAIN
	help
	  Support pin multiplexing and pin configuration control on
	  Bitmain's BM1684 SoC.

config PINCTRL_MANGO
	bool "Sophgo MANGO pinctrl driver"
	depends on ARCH_MANGO && PINCTRL_FULL
	select PINCTRL_BITMAIN
	help
	  Support pin multiplexing and pin configuration control on
	  Sophgo's MANGO SoC.
```
